## fs/u2fs/Kconfig
```kconfig
config U2_FS
	tristate "U2fs stackable file system (EXPERIMENTAL)"
	depends on EXPERIMENTAL
	help
	  U2fs is a stackable unification file system, which appears to
	  merge the contents of two directories (branches), while keeping
	  their physical content separate (see hw2/README).

config U2_DUP_ELIMINATION
	bool "U2fs extended attributes"
	depends on U2_FS
	help
	  Eliminates duplicates entries from readdir call to show user unified directory listing.
```
